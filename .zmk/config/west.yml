## boards/shields/CygnusTP/Kconfig.shield
```kconfig
# Copyright (c) 2020 Pete Johanson
# SPDX-License-Identifier: MIT

config SHIELD_cygnustp_LEFT
    def_bool $(shields_list_contains,corne_left)

config SHIELD_cygnustp_RIGHT
    def_bool $(shields_list_contains,corne_right)
```

## boards/shields/cygnustp/Kconfig.shield
```kconfig
# Copyright (c) 2020 Pete Johanson
# SPDX-License-Identifier: MIT

config SHIELD_CYGNUSTP_LEFT
    def_bool $(shields_list_contains,cygnustp_left)

config SHIELD_CYGNUSTP_RIGHT
    def_bool $(shields_list_contains,cygnustp_right)
```
